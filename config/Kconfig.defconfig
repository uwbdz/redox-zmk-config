## config/Kconfig.defconfig
```kconfig
if SHIELD_REDOX_LEFT

config ZMK_KEYBOARD_NAME
    default "REDOX"
    
config ZMK_SPLIT_ROLE_CENTRAL
    default y

endif

if SHIELD_REDOX_LEFT || SHIELD_REDOX_RIGHT

config ZMK_SPLIT
    default y

endif
```
