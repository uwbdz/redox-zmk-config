/*
 * Copyright (c) 2021 The ZMK Contributors
 *
 * SPDX-License-Identifier: MIT
 */

#include "redox.dtsi"

&kscan0 {
	col-gpios
        = <&pro_micro 02 GPIO_ACTIVE_HIGH>
        , <&pro_micro 03 GPIO_ACTIVE_HIGH>
        , <&pro_micro 04 GPIO_ACTIVE_HIGH>
        , <&pro_micro 05 GPIO_ACTIVE_HIGH>
        , <&pro_micro 06 GPIO_ACTIVE_HIGH>
        , <&pro_micro 07 GPIO_ACTIVE_HIGH>
        , <&pro_micro 08 GPIO_ACTIVE_HIGH>
        , <&pro_micro 09 GPIO_ACTIVE_HIGH>
    ;		
};
